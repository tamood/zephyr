## boards/riscv/e300nexysA7/Kconfig.board
```kconfig
# SPDX-License-Identifier: Apache-2.0

config BOARD_E300NEXYSA7
	bool "e300nexysA7 target"
	depends on SOC_RISCV_SIFIVE_FREEDOM
```

## boards/riscv/e300nexysA7/Kconfig.defconfig
```kconfig
# SPDX-License-Identifier: Apache-2.0

if BOARD_E300NEXYSA7

config BOARD
	default "e300nexysA7"

config SYS_CLOCK_TICKS_PER_SEC
	default 128

config PWM_SIFIVE
	default y
	depends on PWM

endif
```
